## config/west.yml
```yaml
manifest:
  remotes:
    - name: zmkfirmware
      url-base: https://github.com/zmkfirmware
  projects:
    - name: zmk
      remote: zmkfirmware
      revision: v0.3
      import: app/west.yml
    - name: hammerbeam-slideshow
      remote: gpeye
      revision: main
    - name: zmk-nice-oled
      remote: mctechnology17
      revision: main
    - name: nice-view-elemental
      remote: kevinpastor
      revision: main
    - name: nice-view-battery
      remote: infely
      revision: main
  self:
    path: config
```
